## Libraries/rttherad_libraries/Kconfig
```kconfig
config RTT_DIR
    string
    option env="RTT_ROOT"
    default "."
    
source "src/Kconfig"
source "libcpu/Kconfig"
source "components/Kconfig"
```
